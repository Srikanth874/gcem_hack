/*
  ========================================================================
  SolarWatch AI — Virtual ESP32 Solar Sensor (Wokwi Firmware)
  ========================================================================
  Simulates a smart commercial solar string sensor node.
  Generates physics-based telemetry (Voltage, Current, Power, Irradiance,
  Panel Temperature, Ambient Temperature, Cumulative Energy, Efficiency).

  Networking:
    Connects to Wokwi virtual WiFi ("Wokwi-GUEST") and sends HTTP POST JSON
    to your Flask backend via your public forwarding tunnel (ngrok).

  NOTE:
    All measurements generated by this sketch are SIMULATED statistical models.
    No physical sensors or hardware are connected.
  ========================================================================
*/

#include <WiFi.h>
#include <HTTPClient.h>
#include <ArduinoJson.h>

// ----------------------------------------------------------------------
// Configuration & Network Settings
// ----------------------------------------------------------------------
// Wokwi virtual WiFi access point (pre-configured in Wokwi simulator)
const char* WIFI_SSID     = "Wokwi-GUEST";
const char* WIFI_PASSWORD = "";

// REPLACE with your public tunnel URL provided by ngrok or localtunnel
// Using plain http:// avoids heavy TLS handshake overhead in Wokwi simulator
const char* BACKEND_URL = "http://common-camels-begin.loca.lt/api/esp32/data";

// Telemetry interval (2000 milliseconds = 2 seconds for continuous live streaming)
const unsigned long SEND_INTERVAL_MS = 2000;
unsigned long lastSendTime = 0;

// ----------------------------------------------------------------------
// Physical Simulation Variables
// ----------------------------------------------------------------------
float cumulativeEnergyKWh = 0.042; // Starting cumulative energy
float simulationTimeStep  = 0.0;   // Virtual solar diurnal clock

void setup() {
  Serial.begin(115200);
  delay(1000);

  Serial.println("\n=======================================================");
  Serial.println("  SolarWatch AI — Virtual ESP32 Solar String Monitor");
  Serial.println("  Status: Initializing firmware...");
  Serial.println("  Data Mode: SIMULATED / VIRTUAL SENSOR");
  Serial.println("=======================================================");

  connectToWiFi();
}

void loop() {
  // Ensure WiFi connection remains active
  if (WiFi.status() != WL_CONNECTED) {
    Serial.println("[WARN] WiFi connection lost. Reconnecting...");
    connectToWiFi();
  }

  // Periodic sensor reading generation and HTTP POST
  unsigned long currentMillis = millis();
  if (currentMillis - lastSendTime >= SEND_INTERVAL_MS) {
    lastSendTime = currentMillis;
    if (WiFi.status() == WL_CONNECTED) {
      generateAndTransmitTelemetry();
    }
  }

  // Yield 20ms every cycle to feed FreeRTOS watchdog & background WiFi stack
  delay(20);
}

// ----------------------------------------------------------------------
// Connect to Wokwi-GUEST WiFi
// ----------------------------------------------------------------------
void connectToWiFi() {
  if (WiFi.status() == WL_CONNECTED) return;
  Serial.print("[INFO] Connecting to WiFi SSID: ");
  Serial.println(WIFI_SSID);

  WiFi.mode(WIFI_STA);
  WiFi.begin(WIFI_SSID, WIFI_PASSWORD);

  int attempts = 0;
  while (WiFi.status() != WL_CONNECTED && attempts < 25) {
    delay(500);
    Serial.print(".");
    attempts++;
  }

  if (WiFi.status() == WL_CONNECTED) {
    Serial.println("\n[SUCCESS] WiFi Connected!");
    Serial.print("[INFO] ESP32 Assigned IP: ");
    Serial.println(WiFi.localIP());
  } else {
    Serial.println("\n[ERROR] Failed to connect to Wokwi-GUEST WiFi.");
  }
}

// ----------------------------------------------------------------------
// Physics Model & Telemetry Generation
// ----------------------------------------------------------------------
void generateAndTransmitTelemetry() {
  // Advance virtual time (simulates solar movement across sky)
  simulationTimeStep += 0.04;
  if (simulationTimeStep > 6.283) { // 2*PI wrap-around
    simulationTimeStep = 0.0;
  }

  // Diurnal Solar Irradiance Curve (0 to 1000 W/m²)
  // Base sinusoidal curve with small realistic atmospheric jitter
  float solarSunHeight = sin(simulationTimeStep);
  if (solarSunHeight < 0) solarSunHeight = 0; // Nighttime condition

  float atmosphericNoise = ((float)(random(-15, 15))) / 10.0;
  float irradiance = (solarSunHeight * 920.0) + atmosphericNoise;
  if (irradiance < 0.0) irradiance = 0.0;

  // Cloud/shading transient simulation (0% to 35%)
  float shadingLevel = 0.0;
  if (random(0, 10) > 7) {
    shadingLevel = (float)random(10, 35); // Random brief cloud passing
  }
  float effectiveIrradiance = irradiance * (1.0 - (shadingLevel / 100.0));

  // Ambient & Cell Temperature Modeling
  // Ambient temp cycles between 22°C and 34°C
  float ambientTemp = 24.0 + (solarSunHeight * 9.0) + (((float)random(-5, 5)) / 10.0);
  // NOCT cell temperature formula: T_cell = T_ambient + (Irr / 800) * 28°C
  float panelTemp = ambientTemp + (effectiveIrradiance / 800.0 * 26.0) + (((float)random(-3, 3)) / 10.0);

  // Electrical Characteristics:
  // Standard 72-cell module: Voc ~ 38V, Vmp ~ 32V, Imp ~ 8.8A
  // Temperature voltage coefficient: ~ -0.35% / °C above 25°C
  float tempDiff = panelTemp - 25.0;
  float voltage = 0.0;
  float current = 0.0;

  if (effectiveIrradiance > 15.0) {
    // Normal generation
    float baseVoltage = 33.2 - (tempDiff * 0.11);
    voltage = baseVoltage + (((float)random(-4, 4)) / 10.0);
    if (voltage < 24.0) voltage = 24.0;

    // Current is directly proportional to incident irradiance
    current = (effectiveIrradiance / 1000.0) * 8.6 + (((float)random(-3, 3)) / 20.0);
    if (current < 0.0) current = 0.0;
  } else {
    // Insufficient sunlight / night
    voltage = 0.8 + (((float)random(0, 5)) / 10.0);
    current = 0.0;
  }

  // Calculated Power: P = V * I
  float power = voltage * current;

  // Integrate Cumulative Energy (kWh) over the 2-second interval:
  // Energy (kWh) = Power (W) * (2 / 3600) / 1000
  cumulativeEnergyKWh += (power * (SEND_INTERVAL_MS / 1000.0) / 3600.0 / 1000.0);

  // Panel Efficiency Estimate
  // Typical commercial silicon cell is 18-21% at STC, derated by temp
  float efficiency = 0.0;
  if (effectiveIrradiance > 50.0) {
    efficiency = 20.4 - (tempDiff * 0.04) - (shadingLevel * 0.08);
    if (efficiency < 5.0) efficiency = 5.0;
  }

  // Sensor Operational Status
  String sensorStatus = "OPTIMAL";
  if (panelTemp > 65.0) {
    sensorStatus = "OVERHEATING";
  } else if (shadingLevel > 20.0) {
    sensorStatus = "SHADED";
  } else if (effectiveIrradiance > 300.0 && voltage < 27.0) {
    sensorStatus = "LOW_VOLTAGE";
  } else if (effectiveIrradiance < 50.0) {
    sensorStatus = "LOW_LIGHT";
  }

  // --------------------------------------------------------------------
  // Build JSON Payload
  // --------------------------------------------------------------------
  StaticJsonDocument<512> doc;
  doc["voltage"]             = serialized(String(voltage, 2));
  doc["current"]             = serialized(String(current, 2));
  doc["power"]               = serialized(String(power, 2));
  doc["irradiance"]          = serialized(String(effectiveIrradiance, 1));
  doc["panel_temperature"]   = serialized(String(panelTemp, 1));
  doc["ambient_temperature"] = serialized(String(ambientTemp, 1));
  doc["energy_kwh"]          = serialized(String(cumulativeEnergyKWh, 4));
  doc["efficiency"]          = serialized(String(efficiency, 1));
  doc["shading_level"]       = serialized(String(shadingLevel, 1));
  doc["sensor_status"]       = sensorStatus;
  doc["timestamp"]           = String(millis());

  String jsonPayload;
  serializeJson(doc, jsonPayload);

  // Print diagnostic telemetry to Wokwi Serial Monitor
  Serial.println("\n-------------------------------------------------------");
  Serial.printf("[SENSOR TELEMETRY] V: %.2fV | I: %.2fA | P: %.2fW | Irr: %.1f W/m²\n",
                voltage, current, power, effectiveIrradiance);
  Serial.printf("                  T_panel: %.1f°C | T_amb: %.1f°C | Status: %s\n",
                panelTemp, ambientTemp, sensorStatus.c_str());

  // --------------------------------------------------------------------
  // Transmit HTTP POST Request to Flask Backend
  // --------------------------------------------------------------------
  if (String(BACKEND_URL).indexOf("YOUR_HTTPS_TUNNEL_HOST") >= 0) {
    Serial.println("[CONFIG WARNING] BACKEND_URL is still placeholder!");
    Serial.println("  -> Please replace 'YOUR_HTTPS_TUNNEL_HOST/sensor' with your actual ngrok URL.");
    return;
  }

  WiFiClient client;
  HTTPClient http;
  http.setTimeout(4000);
  http.setReuse(false);

  http.begin(client, BACKEND_URL);
  http.addHeader("Content-Type", "application/json");
  http.addHeader("bypass-tunnel-reminder", "true");

  // HTTP POST with JSON body
  int httpResponseCode = http.POST(jsonPayload);

  if (httpResponseCode > 0) {
    String response = http.getString();
    Serial.printf("[HTTP SUCCESS] Response Code: %d\n", httpResponseCode);
    Serial.printf("[HTTP RESPONSE] %s\n", response.c_str());
  } else {
    Serial.printf("[HTTP ERROR] Failed to send POST, error: %s\n", http.errorToString(httpResponseCode).c_str());
    Serial.println("[HINT] Verify that localtunnel or backend is active.");
  }

  http.end();
}
